## apps/note4c-firmware/main/Kconfig.projbuild
```kconfig
menu "NOTE4C firmware"

config NOTE4C_FAKE_DISPLAY
    bool "Use fake display backend"
    default y
    help
        Keep enabled for host-side and first-build validation. Disable only
        after backing up the device flash and confirming the NOTE4C label. The
        real backend is adapted from the NOTE4C four-color SSD2683 reference
        firmware. The black-and-white NOTE4 driver is never accepted here.

config NOTE4C_COLOR_TEST_PATTERN
    bool "Show the first-hardware-test color bars"
    default n
    depends on !NOTE4C_FAKE_DISPLAY
    help
        Render black, white, red, and yellow vertical bars and disable TODO
        interaction. Keep enabled for the first controlled NOTE4C display test.

endmenu
```

## apps/note4c-firmware/sdkconfig.defaults
```kconfig
CONFIG_IDF_TARGET="esp32s3"
CONFIG_ESPTOOLPY_FLASHSIZE_16MB=y
CONFIG_SPIRAM=y
CONFIG_SPIRAM_MODE_OCT=y
CONFIG_FREERTOS_HZ=1000
CONFIG_LOG_DEFAULT_LEVEL_INFO=y
CONFIG_ESP_MAIN_TASK_STACK_SIZE=10000
CONFIG_PARTITION_TABLE_SINGLE_APP_LARGE=y
CONFIG_BT_ENABLED=y
CONFIG_BT_BLE_ENABLED=y
CONFIG_BT_BLUEDROID_ENABLED=n
CONFIG_BT_NIMBLE_ENABLED=y
CONFIG_BT_NIMBLE_ROLE_CENTRAL=n
CONFIG_BT_NIMBLE_ROLE_OBSERVER=n
CONFIG_BT_NIMBLE_ROLE_PERIPHERAL=y
CONFIG_BT_NIMBLE_ROLE_BROADCASTER=y
CONFIG_BT_NIMBLE_MAX_CONNECTIONS=1
CONFIG_BT_NIMBLE_NVS_PERSIST=y
CONFIG_BT_NIMBLE_SM_SC=y
CONFIG_BT_NIMBLE_SM_SC_ONLY=y
CONFIG_BTDM_CTRL_MODE_BLE_ONLY=y
CONFIG_BTDM_CTRL_MODE_BR_EDR_ONLY=n
CONFIG_BTDM_CTRL_MODE_BTDM=n
```
